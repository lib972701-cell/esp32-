## components/App/Fall/Kconfig.projbuild
```kconfig
menu "Fall detection (ESP32-S3 + MPU-6050)"

    menu "IMU wiring"
        comment "I2C0 on the ATK-DNESP32S3 is IO41 (SDA) / IO42 (SCL) and is shared with"
        comment "AP3216C, ES8388, 24C02 and the XL9555 expander - confirm the module wiring"
        comment "against the schematic before connecting anything. Do not guess pins."

        config FALL_IMU_I2C_PORT
            int "I2C peripheral port"
            range 0 1
            default 0

        config FALL_IMU_SDA_GPIO
            int "I2C SDA GPIO"
            default 4
            help
                Measured on this bench unit: the GY-521 is wired to IO4/IO5, not to the
                board's onboard I2C0 (IO41/IO42, which already carries the codec, light
                sensor, accelerometer, IO expander and EEPROM). This application never
                searches other GPIO pairs. Correct the configured wiring when absent.

        config FALL_IMU_SCL_GPIO
            int "I2C SCL GPIO"
            default 5

        config FALL_IMU_I2C_HZ
            int "I2C clock frequency (Hz)"
            default 400000

        config FALL_IMU_ADDR_8BIT
            hex "IMU I2C address in 8-bit form"
            default 0xD0
            help
                MPU-6050: 0xD0 when ADO is low (7-bit 0x68), 0xD2 when ADO is high (0x69).

        config FALL_CALIB_MS
            int "Static calibration window at boot (ms, 0 = skip)"
            default 2000
            help
                The device must be perfectly still for this long after reset: the
                gyroscope zero-rate bias and the accelerometer magnitude scale are
                estimated from the window, then applied to every sample. Without it the
                gyro offset integrates into yaw (-2 deg/s was measured on this bench unit)
                and a |a| error biases the quiet/energy features. A window that moved is
                rejected rather than applied silently.

        config FALL_CALIB_TRIES
            int "Calibration attempts before giving up"
            default 5
            help
                Each attempt is FALL_CALIB_MS long. A window that moved is rejected and
                another is tried, so the operator does not have to reset at exactly the
                right moment. With 5 x 2000 ms the boot waits at most 10 s.

    endmenu

    menu "MPU-6050 sampling"
        config FALL_IMU_ODR_HZ
            int "Accelerometer / gyroscope output data rate (Hz)"
            range 1 1000
            default 125
            help
                With DLPF enabled the reference clock is 1 kHz. The driver picks
                the nearest integer divider and reports the actual sample rate.

        config FALL_IMU_PERIOD_MS
            int "imu_task period (ms)"
            range 1 1000
            default 8
    endmenu

    menu "Fall decision thresholds (starting points - calibrate by replay)"

        config FALL_ACC_IMPACT_MG
            int "Impact candidate: acceleration magnitude (milli-g)"
            default 2500
            help
                Kept at 2.5 g. Measured over 47 hand-held trials: simulated falls peaked at
                1.06-1.71 g and normal handling at 1.09-1.74 g, so this criterion never fires
                for hand-held motion - it only does its job when the device really hits
                something (an earlier swing that struck a surface reached 2.78 g). Lowering
                it to 1.7 g changed the calibration result by at most one trial.

        config FALL_GYRO_IMPACT_MDPS
            int "Impact candidate: angular rate magnitude (milli-dps)"
            default 120000
            help
                Calibrated by replaying the recorded acceptance run through the real
                detector (tools/calibrate_from_recording.py). Measured trade-off with the
                gravity-tilt threshold at 30 deg:
                  120 dps -> 14/20 falls caught, 3/27 normal false triggers
                  150 dps -> 10/20, 3/27
                  200 dps ->  5/20, 2/27
                  300 dps ->  2/20, 1/27
                A missed fall is the safety-relevant error and a false trigger can be
                cancelled within the 15 s window, so the recall-favouring 120 dps is the
                default. Raise it if false triggers matter more in your deployment.

        config FALL_TILT_CHANGE_MDEG
            int "Required gravity-tilt change after the impact (milli-degrees)"
            default 30000
            help
                The angle between the gravity direction at the impact candidate and the
                gravity direction now. Yaw is deliberately excluded: without a magnetometer
                it is unobservable and carried by gyro integration alone, so turning on the
                spot would otherwise satisfy a posture-change test - that was a real false
                trigger on the bench (a turn showed 45.6 deg of yaw and 7.6 deg of tilt).
                Calibrated trade-off with gyro at 120 dps:
                  25 deg -> 14/20 falls, 5/27 false
                  30 deg -> 14/20 falls, 3/27 false
                  35 deg -> 10/20 falls, 2/27 false
                  45 deg ->  5/20 falls, 1/27 false

        config FALL_TILT_TIME_MAX_MS
            int "Posture change must be reached within (ms, 0 = no limit)"
            range 0 5000
            default 0
            help
                Time from the impact candidate to the moment the gravity tilt
                crosses FALL_TILT_CHANGE_MDEG. 0 keeps the untimed rule.

                DEFAULT 0 IS A MEASURED DECISION. Replaying the recorded 47-trial
                run shows the posture-change time does not separate the classes: the
                14 confirmed hand-held simulated falls reached their tilt in
                960-2976 ms (median 1632), and the 3 false-triggering normal actions
                took 1344-2064 ms (median 1968) - the normal actions sit inside the
                falls' range and their tilt is even larger. A limit tight enough to
                remove those false triggers (below 1344 ms) also removes five of the
                fourteen falls. It measures how fast an operator moved a hand, not
                the physics of a fall.

                A real fall completes its posture change in a few hundred
                milliseconds, so this is the right shape for a body-worn trial; but
                it must be calibrated with real fall data. Enabling it on the
                strength of the hand-held recording would trade recall for nothing.
                The grid is in evidence/calibration-report.txt; the per-trial times
                are in evidence/posture-timing.txt.

        config FALL_QUIET_BAND_MG
            int "Low-motion band around 1 g (milli-g)"
            default 300

        config FALL_QUIET_GYRO_MDPS
            int "Low-motion angular rate limit (milli-dps)"
            default 60000

        config FALL_QUIET_MIN_MS
            int "Low-motion stage duration (ms)"
            default 400

        config FALL_SETTLE_ENERGY_UG2
            int "Motion-settled energy threshold (micro-g^2)"
            default 50000

        config FALL_REQUIRE_QUIET_PHASE
            bool "Require the full low-motion stage before confirming"
            default n
            help
                Off by default: the low-motion stage is a supporting feature, not a
                hard requirement, so that soft falls are not excluded.

        config FALL_VERIFY_WINDOW_MS
            int "Impact to confirmation deadline (ms)"
            default 3000

        config FALL_MAX_IMPACTS
            int "Distinct acceleration impacts allowed while verifying"
            default 3

        config FALL_REFRACTORY_MS
            int "Refractory after a cancel or a completed event (ms)"
            default 5000
    endmenu

endmenu
```

## components/App/Kconfig.projbuild
```kconfig
menu "Fall startup calibration"
        config FALL_CALIB_MS
            int "Static calibration window at boot (ms, 0 = skip)"
            default 2000
            help
                The device must be perfectly still for this long after reset: the
                gyroscope zero-rate bias and the accelerometer magnitude scale are
                estimated from the window, then applied to every sample. Without it the
                gyro offset integrates into yaw (-2 deg/s was measured on this bench unit)
                and a |a| error biases the quiet/energy features. A window that moved is
                rejected rather than applied silently.

        config FALL_CALIB_TRIES
            int "Calibration attempts before giving up"
            default 5
            help
                Each attempt is FALL_CALIB_MS long. A window that moved is rejected and
                another is tried, so the operator does not have to reset at exactly the
                right moment. With 5 x 2000 ms the boot waits at most 10 s.

endmenu
```

## components/BSP/Kconfig.projbuild
```kconfig
menu "Serial 4G mail prototype"
config MAIL_DTU_TX_GPIO
    int "DTU UART1 TX GPIO (DNESP32S3 P1 pin7)"
    range 17 18
    default 17
config MAIL_DTU_RX_GPIO
    int "DTU UART1 RX GPIO (DNESP32S3 P1 pin8)"
    range 17 18
    default 18
endmenu

rsource "MPU6050/Kconfig.projbuild"

menu "External MaixCAM2 vision UART2"
config VISION_UART_ENABLE
    bool "Enable vision UART2 after wiring confirmation"
    default n
    help
        UART0 is the log console and UART1 belongs to the DTU.
        Enable only after confirming both boards' IO levels, pins and common GND.
config VISION_TX_GPIO
    int "ESP32 UART2 TX GPIO (DNESP32S3 P1 pin3)"
    range -1 48
    default 6
config VISION_RX_GPIO
    int "ESP32 UART2 RX GPIO (DNESP32S3 P1 pin6; IO7 reserved for IMU INT)"
    range -1 48
    default 16
endmenu
```

## components/BSP/MPU6050/Kconfig.projbuild
```kconfig
menu "MPU6050 hardware"
    menu "IMU wiring"
        comment "I2C0 on the ATK-DNESP32S3 is IO41 (SDA) / IO42 (SCL) and is shared with"
        comment "AP3216C, ES8388, 24C02 and the XL9555 expander - confirm the module wiring"
        comment "against the schematic before connecting anything. Do not guess pins."

        config FALL_IMU_I2C_PORT
            int "I2C peripheral port"
            range 0 1
            default 0

        config FALL_IMU_SDA_GPIO
            int "I2C SDA GPIO"
            default 4
            help
                Measured on this bench unit: the GY-521 is wired to IO4/IO5, not to the
                board's onboard I2C0 (IO41/IO42, which already carries the codec, light
                sensor, accelerometer, IO expander and EEPROM). This application never
                searches other GPIO pairs. Correct the configured wiring when absent.

        config FALL_IMU_SCL_GPIO
            int "I2C SCL GPIO"
            default 5

        config FALL_IMU_I2C_HZ
            int "I2C clock frequency (Hz)"
            default 400000

        config FALL_IMU_ADDR_8BIT
            hex "IMU I2C address in 8-bit form"
            default 0xD0
            help
                MPU-6050: 0xD0 when ADO is low (7-bit 0x68), 0xD2 when ADO is high (0x69).

    endmenu

    menu "MPU-6050 sampling"
        config FALL_IMU_ODR_HZ
            int "Accelerometer / gyroscope output data rate (Hz)"
            range 1 1000
            default 125
            help
                With DLPF enabled the reference clock is 1 kHz. The driver picks
                the nearest integer divider and reports the actual sample rate.

        config FALL_IMU_PERIOD_MS
            int "imu_task period (ms)"
            range 1 1000
            default 8
    endmenu

endmenu
```

## components/CloudAI/Kconfig.projbuild
```kconfig
menu "KEY0 cloud voice conversation"
    config CLOUD_AI_ENABLE
        bool "Enable cloud voice conversation"
        default n
    config OTA_URL
        string "Xiaozhi service discovery URL"
        default "https://api.tenclass.net/xiaozhi/ota/"
        depends on CLOUD_AI_ENABLE
endmenu
```
